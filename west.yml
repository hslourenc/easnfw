## west.yml
```yaml
manifest:
  self:
    west-commands: scripts/west-commands.yml

  remotes:
    - name: ncs
      url-base: https://github.com/nrfconnect

  projects:
    - name: nrf
      remote: ncs
      repo-path: sdk-nrf
      revision: v3.4.2
      import: true
    - name: onomondo-softsim
      url: https://github.com/onomondo/nrf-softsim.git
      path: modules/lib/onomondo-softsim
      revision: v7.0.0
      submodules: true
```
